## drivers/sensors/Kconfig
```kconfig
config SENSORS_SSC
	bool "Enable Sensors Driver Support for SSC"
	help
	  Add support for sensors SSC driver.
	  This driver is used for exercising sensors use case,
	  time syncing with ADSP clock.
config INPUT_CM3323E
	tristate "CM3323E RGB color sensor"
	depends on I2C
	help
	  Say Y here to enable the CM3323E RGB Color Sensor.
config SYNAPTICS_SPIDRV
	tristate "FingerPrint sensor"
	depends on SPI_MASTER
	help
	  add for support FP Sensor.
```
