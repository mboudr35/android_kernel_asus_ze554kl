
qcom,2893530_asus_c11p1618cos_3150mah_averaged_masterslave_apr18th2017 {
	qcom, = <24>;
	/* #2893530_Asus_C11P1618cos_3150mAh_averaged_MasterSlave_Apr18th2017*/
	qcom,max-voltage-uv = <4350000>;
	qcom,fg-cc-cv-threshold-mv = <4340>;	
	qcom,nom-batt-capacity-mah = <3150>;
	qcom,batt-id-kohm = <51>;
	qcom,battery-beta = <3435>;
	qcom,battery-type = "c11p1618cos_3150mah_apr18th2017";
	qcom,checksum = <0xBB5E>;
	qcom,gui-version = "PM660GUI - 0.0.0.36";
	qcom,fg-profile-data = [
		 9D 1F 8F 05
		 69 0A B5 FC
		 63 1D 7C ED
		 29 0B 6D 15
		 94 18 DD 22
		 B7 45 7A 52
		 5C 00 00 00
		 0F 00 00 00
		 00 00 7F C4
		 AC C5 9D BA
		 17 00 08 00
		 CC D3 52 E5
		 3D F4 C2 EA
		 16 DA BA 03
		 82 05 7E 13
		 1B 06 09 20
		 27 00 14 00
		 CB 1F 92 05
		 59 0A 72 06
		 44 1D C1 00
		 41 02 0E 0D
		 D8 18 18 23
		 3F 45 57 53
		 5B 00 00 00
		 0E 00 00 00
		 00 00 B6 CC
		 5B B2 D8 C2
		 15 00 00 00
		 35 EA 52 E5
		 8D F4 55 00
		 FB EA 3F 03
		 3E EC 7E 1B
		 B7 33 CC FF
		 07 10 00 00
		 02 0C 99 45
		 15 00 40 00
		 9F 01 0A FA
		 FF 00 00 00
		 00 00 00 00
		 00 00 00 00
		 00 00 00 00
		 00 00 00 00
		 00 00 00 00
		 00 00 00 00
		 00 00 00 00
		 00 00 00 00
		 00 00 00 00
		 00 00 00 00
		 00 00 00 00
		 00 00 00 00
		 00 00 00 00
		 00 00 00 00
		 00 00 00 00
		 00 00 00 00
		 00 00 00 00
		 00 00 00 00
	];
};
