/* Copyright (c) 2013, The Linux Foundation. All rights reserved.
 *
 * This program is free software; you can redistribute it and/or modify
 * it under the terms of the GNU General Public License version 2 and
 * only version 2 as published by the Free Software Foundation.
 *
 * This program is distributed in the hope that it will be useful,
 * but WITHOUT ANY WARRANTY; without even the implied warranty of
 * MERCHANTABILITY or FITNESS FOR A PARTICULAR PURPOSE.  See the
 * GNU General Public License for more details.
 */

/*---------------------------------------------------------------------------
 * This file is autogenerated file using gcdb parser. Please do not edit it.
 * Update input XML file to add a new entry or update variable in this file
 * VERSION = "1.0"
 *---------------------------------------------------------------------------*/
&mdss_mdp {
	dsi_boe_td4300_1080p_video: qcom,mdss_dsi_boe_td4300_1080p_video {
		qcom,mdss-dsi-panel-name = "boe td4300 1080p video mode dsi panel";
		qcom,mdss-dsi-panel-controller = <&mdss_dsi0>;
		qcom,mdss-dsi-panel-type = "dsi_video_mode";
		qcom,mdss-dsi-panel-destination = "display_1";
		qcom,mdss-dsi-panel-framerate = <60>;
		qcom,mdss-dsi-virtual-channel-id = <0>;
		qcom,mdss-dsi-stream = <0>;
		qcom,mdss-dsi-panel-width = <1080>;
		qcom,mdss-dsi-panel-height = <1920>;
		qcom,mdss-dsi-h-front-porch = <90>;
		qcom,mdss-dsi-h-back-porch = <16>;
		qcom,mdss-dsi-h-pulse-width = <8>;
		qcom,mdss-dsi-h-sync-skew = <0>;
		qcom,mdss-dsi-v-back-porch = <4>;
		qcom,mdss-dsi-v-front-porch = <4>;
		qcom,mdss-dsi-v-pulse-width = <2>;
		qcom,mdss-dsi-h-left-border = <0>;
		qcom,mdss-dsi-h-right-border = <0>;
		qcom,mdss-dsi-v-top-border = <0>;
		qcom,mdss-dsi-v-bottom-border = <0>;
		qcom,mdss-dsi-bpp = <24>;
		qcom,mdss-dsi-color-order = "rgb_swap_rgb";
		qcom,mdss-dsi-underflow-color = <0xff>;
		qcom,mdss-dsi-border-color = <0>;
		qcom,mdss-dsi-on-command = [
			05 01 00 00 50 00 02 11 00
			29 01 00 00 00 00 02 B0 04
			29 01 00 00 00 00 2E C1 84 08 00 FF FF 2F 7F BC 4A 99 F3 D4 67 CD B9 C6 BE 02 C7 28 75 C5 1F FF FF 0F 00 00 00 00 00 00 00 00 40 00 22 03 02 03 82 00 01 00 01
			29 01 00 00 0a 00 12 CB D0 BF DF BF 00 00 23 40 0C 00 D0 1C 80 B3 00 00 40
			05 01 00 00 0a 00 02 29 00
			39 01 00 00 00 00 02 51 00
			39 01 00 00 00 00 02 53 24
			39 01 00 00 00 00 02 55 00];
		qcom,mdss-dsi-cabc-on-command = [
			05 01 00 00 50 00 02 11 00
			29 01 00 00 00 00 02 B0 04
			29 01 00 00 00 00 2E C1 84 08 00 FF FF 2F 7F BC 4A 99 F3 D4 67 CD B9 C6 BE 02 C7 28 75 C5 1F FF FF 0F 00 00 00 00 00 00 00 00 40 00 22 03 02 03 82 00 01 00 01
			29 01 00 00 0a 00 12 CB D0 BF DF BF 00 00 23 40 0C 00 D0 1C 80 B3 00 00 40
			05 01 00 00 0a 00 02 29 00
			39 01 00 00 00 00 02 51 00
			39 01 00 00 00 00 02 53 24
			39 01 00 00 00 00 02 55 82];
		qcom,mdss-dsi-off-command = [05 01 00 00 14 00 02 28 00
			29 01 00 00 00 00 02 B0 00
			29 01 00 00 00 00 2E C1 84 08 00 FF FF AF BE 52 4A 19 A5 D4 57 4A 29 A5 BE 52 CA 28 A5 D4 57 FF FF 0F 00 00 00 00 00 00 00 00 40 00 22 03 02 03 82 00 01 00 01
			29 01 00 00 14 00 12 CB D0 BF DF BF 00 00 20 40 00 00 D0 1F 80 BF 00 00 40
			29 01 00 00 00 00 02 B0 03
			05 01 00 00 78 00 02 10 00];
		qcom,mdss-dsi-on-command-state = "dsi_lp_mode";
		qcom,mdss-dsi-off-command-state = "dsi_lp_mode";
		qcom,mdss-dsi-h-sync-pulse = <1>;
		qcom,mdss-dsi-traffic-mode = "burst_mode";
		qcom,mdss-dsi-lane-map = "lane_map_0123";
		qcom,mdss-dsi-bllp-eof-power-mode;
		qcom,mdss-dsi-bllp-power-mode;
		qcom,mdss-dsi-lane-0-state;
		qcom,mdss-dsi-lane-1-state;
		qcom,mdss-dsi-lane-2-state;
		qcom,mdss-dsi-lane-3-state;
		qcom,mdss-dsi-lp11-init;
		qcom,esd-check-enabled;
		qcom,mdss-dsi-panel-status-check-mode = "reg_read";
		qcom,mdss-dsi-panel-status-command = [06 01 00 01 05 00 02 0A 00];
		qcom,mdss-dsi-panel-status-command-state = "dsi_lp_mode";
		qcom,mdss-dsi-panel-status-read-length = <1>;
		qcom,mdss-dsi-panel-status-value = <0x1c>;
		qcom,mdss-dsi-panel-timings = [E6 38 26 00 68 6c 2A 3C 2C 03 04 00];
		qcom,mdss-dsi-panel-timings-phy-v2 = [31 2a 11 14 0d 03 04 a0
			31 2a 11 14 0d 03 04 a0
			31 2a 11 14 0d 03 04 a0
			31 2a 11 14 0d 03 04 a0
			31 3e 11 14 0d 03 04 a0];
		qcom,mdss-dsi-t-clk-post = <0x0D>;
		qcom,mdss-dsi-t-clk-pre = <0x2D>;
		qcom,mdss-dsi-bl-min-level = <2>;
		qcom,mdss-dsi-bl-max-level = <255>;
		qcom,mdss-dsi-dma-trigger = "trigger_sw";
		qcom,mdss-dsi-mdp-trigger = "none";
		qcom,mdss-dsi-bl-pmic-control-type = "bl_ctrl_dcs";
		qcom,mdss-dsi-reset-sequence = <1 10>, <0 10>, <1 10>;
		qcom,mdss-pan-physical-width-dimension = <68>; //width of picture in mm (for xdpi)
		qcom,mdss-pan-physical-height-dimension = <121>; //height of picture in mm (for ydpi)
		qcom,ulps-enabled;
		//qcom,suspend-ulps-enabled;
	};
};
