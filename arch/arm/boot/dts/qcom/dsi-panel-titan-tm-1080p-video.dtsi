/* Copyright (c) 2013, The Linux Foundation. All rights reserved.
 *
 * This program is free software; you can redistribute it and/or modify
 * it under the terms of the GNU General Public License version 2 and
 * only version 2 as published by the Free Software Foundation.
 *
 * This program is distributed in the hope that it will be useful,
 * but WITHOUT ANY WARRANTY; without even the implied warranty of
 * MERCHANTABILITY or FITNESS FOR A PARTICULAR PURPOSE.  See the
 * GNU General Public License for more details.
 */

/*---------------------------------------------------------------------------
 * This file is autogenerated file using gcdb parser. Please do not edit it.
 * Update input XML file to add a new entry or update variable in this file
 * VERSION = "1.0"
 *---------------------------------------------------------------------------*/
&mdss_mdp {
	dsi_titan_tm_1080p_video: qcom,mdss_dsi_titan_tm_1080p_video {
		qcom,mdss-dsi-panel-name = "titan tm 1080p video mode dsi panel";
		qcom,mdss-dsi-panel-controller = <&mdss_dsi0>;
		qcom,mdss-dsi-panel-type = "dsi_video_mode";
		qcom,mdss-dsi-panel-destination = "display_1";
		qcom,mdss-dsi-panel-framerate = <60>;
		qcom,mdss-dsi-virtual-channel-id = <0>;
		qcom,mdss-dsi-stream = <0>;
		qcom,mdss-dsi-panel-width = <1080>;
		qcom,mdss-dsi-panel-height = <1920>;
		qcom,mdss-dsi-h-front-porch = <32>;
		qcom,mdss-dsi-h-back-porch = <32>;
		qcom,mdss-dsi-h-pulse-width = <4>;
		qcom,mdss-dsi-h-sync-skew = <0>;
		qcom,mdss-dsi-v-back-porch = <16>;
		qcom,mdss-dsi-v-front-porch = <16>;
		qcom,mdss-dsi-v-pulse-width = <2>;
		qcom,mdss-dsi-h-left-border = <0>;
		qcom,mdss-dsi-h-right-border = <0>;
		qcom,mdss-dsi-v-top-border = <0>;
		qcom,mdss-dsi-v-bottom-border = <0>;
		qcom,mdss-dsi-bpp = <24>;
		qcom,mdss-dsi-color-order = "rgb_swap_rgb";
		qcom,mdss-dsi-underflow-color = <0xff>;
		qcom,mdss-dsi-border-color = <0>;
		qcom,mdss-dsi-on-command = [
			13 01 00 00 00 00 02 00 00
			29 01 00 00 00 00 04 ff 87 16 01
			13 01 00 00 00 00 02 00 80
			29 01 00 00 00 00 03 ff 87 16
			13 01 00 00 00 00 02 00 B0
			29 01 00 00 00 00 04 CA 00 00 04
			13 01 00 00 00 00 02 00 00
			29 01 00 00 00 00 04 ff 00 00 00
			13 01 00 00 00 00 02 00 80
			29 01 00 00 00 00 03 ff 00 00
			15 01 00 00 00 00 02 55 00
			15 01 00 00 00 00 02 53 24
			29 01 00 00 00 00 03 51 00 00
			05 01 00 00 64 00 02 11 00
			05 01 00 00 00 00 02 29 00];
		qcom,mdss-dsi-cabc-on-command = [
			13 01 00 00 00 00 02 00 00
			29 01 00 00 00 00 04 ff 87 16 01
			13 01 00 00 00 00 02 00 80
			29 01 00 00 00 00 03 ff 87 16
			13 01 00 00 00 00 02 00 B0
			29 01 00 00 00 00 04 CA 00 00 04
			13 01 00 00 00 00 02 00 00
			29 01 00 00 00 00 04 ff 00 00 00
			13 01 00 00 00 00 02 00 80
			29 01 00 00 00 00 03 ff 00 00
			15 01 00 00 00 00 02 55 02
			15 01 00 00 00 00 02 53 24
			29 01 00 00 00 00 03 51 00 00
			05 01 00 00 64 00 02 11 00
			05 01 00 00 00 00 02 29 00];
		qcom,mdss-dsi-off-command = [05 01 00 00 32 00 02 28 00
			05 01 00 00 78 00 02 10 00
			15 01 00 00 00 00 02 00 00
			39 01 00 00 00 00 05 F7 5A A5 87 16];
		qcom,mdss-dsi-on-command-state = "dsi_lp_mode";
		qcom,mdss-dsi-off-command-state = "dsi_lp_mode";
		qcom,mdss-dsi-h-sync-pulse = <1>;
		qcom,mdss-dsi-traffic-mode = "burst_mode";
		qcom,mdss-dsi-lane-map = "lane_map_0123";
		qcom,mdss-dsi-bllp-eof-power-mode;
		qcom,mdss-dsi-bllp-power-mode;
		qcom,mdss-dsi-lane-0-state;
		qcom,mdss-dsi-lane-1-state;
		qcom,mdss-dsi-lane-2-state;
		qcom,mdss-dsi-lane-3-state;
		qcom,mdss-dsi-lp11-init;
		qcom,mdss-dsi-panel-timings = [D6 32 22 00 60 66 26 36 28 03 04 00];
		qcom,mdss-dsi-panel-timings-phy-v2 = [31 2a 11 14 0d 03 04 a0
			31 2a 11 14 0d 03 04 a0
			31 2a 11 14 0d 03 04 a0
			31 2a 11 14 0d 03 04 a0
			31 3e 11 14 0d 03 04 a0];
		qcom,mdss-dsi-t-clk-post = <0x03>;
		qcom,mdss-dsi-t-clk-pre = <0x28>;
		qcom,mdss-dsi-bl-min-level = <8>;
		qcom,mdss-dsi-bl-max-level = <1023>;
		qcom,mdss-dsi-dma-trigger = "trigger_sw";
		qcom,mdss-dsi-mdp-trigger = "none";
		qcom,mdss-dsi-bl-pmic-control-type = "bl_ctrl_dcs";
		qcom,mdss-dsi-reset-sequence = <1 1>, <0 1>, <1 2>;
		qcom,mdss-pan-physical-width-dimension = <68>; //width of picture in mm (for xdpi)
		qcom,mdss-pan-physical-height-dimension = <121>; //height of picture in mm (for ydpi)
		qcom,ulps-enabled;
	};
};
